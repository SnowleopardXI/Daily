/dts-v1/;
/plugin/;

/{
        compatible="ti,beaglebone","ti,beaglebone-black","ti,beaglebone-green";

        part-number="BB-ADC";
        version="00A0";

        exclusive-use=
                "p9.39",
                "p9.40",
                "p9.37",
                "p9.38",
                "p9.33",
                "p9.36",
                "p9.35",

                "tscadc";
        fragment@0{
                target=<&tscadc>;
                __overlay__{
                        status="okay";
                        adc{
                                ti,adc-channels=<0 1 2 3 4 5 6>;
                        };
                };
        };
};